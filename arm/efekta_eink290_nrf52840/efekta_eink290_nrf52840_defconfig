## arm/efekta_eink290_nrf52840/efekta_eink290_nrf52840_defconfig
```kconfig
# Copyright (c) 2021 Nordic Semiconductor ASA
# SPDX-License-Identifier: Apache-2.0

CONFIG_SOC_SERIES_NRF52X=y
CONFIG_SOC_NRF52840_QIAA=y
CONFIG_BOARD_EFEKTA_EINK290_NRF52840=y
CONFIG_NRFX_SAADC=y

# Enable MPU
CONFIG_ARM_MPU=y
CONFIG_ADC=y
CONFIG_ADC_ASYNC=y
CONFIG_I2C=y

CONFIG_NFCT_PINS_AS_GPIOS=y
CONFIG_GPIO_AS_PINRESET=y
```
